#ifndef MOD_OLED_C
#define MOD_OLED_C

#include "oled.h"
#include "mod_audio.c"

/* OLED */

//   A07 DATA
//   A05 CLK
//   A04 CS    (dedicated NSS, but we do it manually)
//   A03 DC
//   A02 RES

// see oled.h


uint8_t oled_fb[8*128];


/* Seems to work up to 36MHz even on dinky bread board with 5cm wires,
   but at that speed we have trouble feeding it fast enough so there
   doesn't seem to be a reason to go that high. */
#define OLED_DIV SPI_CR1_BAUDRATE_FPCLK_DIV_4 // 18 MHz
// #define OLED_DIV SPI_CR1_BAUDRATE_FPCLK_DIV_8 // 9 MHz
// #define OLED_DIV SPI_CR1_BAUDRATE_FPCLK_DIV_2 // 36 MHz

// The command squences involves the command pin and multiple page
// write commands.  Doesn't seem worth the effort to do it with DMA.


//          rcc_gpio   rcc_spi   spi   rst       gpio   out in  sck  mode        div
// -----------------------------------------------------------------------------------------------------------
const struct hw_spi_nodma hw_oled_spi[] = {
    [1] = { RCC_GPIOA, RCC_SPI1, SPI1, RST_SPI1, GPIOA,  7,  6,  5,  HW_SPI_1WR, OLED_DIV},
    [2] = { RCC_GPIOB, RCC_SPI2, SPI2, RST_SPI2, GPIOB, 15, 14, 13,  HW_SPI_1WR, OLED_DIV},
};

#define C_OLED_SPI hw_oled_spi[1]
#define OLED_CS  GPIOA,4
#define OLED_DC  GPIOA,3
#define OLED_RES GPIOA,2


static inline void oled_cs(int val) {
    hw_gpio_write(OLED_CS, val);
}
static inline void oled_dc(int val) {
    hw_gpio_write(OLED_DC, val);
}
static inline void oled_res(int val) {
    hw_gpio_write(OLED_RES, val);
}
/* Keep filling the tx buffer, and wait for TX end after last byte. */
static inline void oled_bytes_noflush(const uint8_t *b, uint32_t n) {
    while(n--) { hw_spi_nodma_wr(C_OLED_SPI, *b++); }
}
static inline void oled_fill_noflush(uint8_t b, uint32_t n) {
    while(n--) { hw_spi_nodma_wr(C_OLED_SPI, b); }
}
static inline void oled_byte_noflush(const uint8_t b) {
    oled_bytes_noflush(&b, 1);
}
static inline void oled_flush(void) {
    hw_spi_nodma_end(C_OLED_SPI);
}
#define CMD(b) oled_byte_noflush(b);
static inline void oled_init(void) {
    hw_spi_nodma_init(C_OLED_SPI);
    hw_gpio_write(OLED_CS, 1);
    hw_gpio_write(OLED_DC, 0);
    hw_gpio_write(OLED_RES, 1);
    hw_gpio_config(OLED_CS, HW_GPIO_CONFIG_OUTPUT);
    hw_gpio_config(OLED_DC, HW_GPIO_CONFIG_OUTPUT);
    hw_gpio_config(OLED_RES, HW_GPIO_CONFIG_OUTPUT);
    oled_res(0);
    // FIXME: hw_busywait_ms() causes a high level hang here.
    // Can't properly isolate it at this time so just beware of this in the future
    // Works 2014 compiler but has issue with newer
    // arm-none-eabi-gcc (GNU Tools for ARM Embedded Processors) 4.8.4 20140526 (release) [ARM/embedded-4_8-branch revision 211358] (download from ARM)
    // arm-none-eabi-gcc (GNU Tools for Arm Embedded Processors 8-2018-q4-major) 8.2.1 20181213 (release) [gcc-8-branch revision 267074] (Nixos)
    // hw_busywait_ms(10);
    hw_busywait_us(10000);
    oled_res(1);
    oled_dc(0);
    oled_cs(0);
    uint8_t contrast = 128;
    OLED_INIT(CMD,contrast);
    oled_flush();
    oled_cs(1);
    for (int i=0;i<sizeof(oled_fb);i++) {
        oled_fb[i] = i;
    }
}
void oled_send_fb(void) {
    oled_cs(0);
    for (int p=0; p<8; p++) {
        oled_dc(0);
        OLED_PAGE(CMD, p, 0);
        oled_flush();
        oled_dc(1);
        oled_bytes_noflush(&oled_fb[p*128], 128);
        oled_flush();
    }
    oled_cs(1);
}
void oled_clear(void) {
    oled_cs(0);
    for (int p=0; p<8; p++) {
        oled_dc(0);
        OLED_PAGE(CMD, p, 0);
        oled_flush();
        oled_dc(1);
        oled_fill_noflush(0, 128);
        oled_flush();
    }
    oled_cs(1);
}
// https://raw.githubusercontent.com/adafruit/Adafruit-GFX-Library/master/glcdfont.c
const unsigned char font[];

static inline const uint8_t *font_char(int c) {
    return &font[5*c];
}
void oled_send_text(int page, int column, char *text) {
    oled_cs(0);
    oled_dc(0);
    OLED_PAGE(CMD, page, column);
    oled_flush();
    oled_dc(1);
    for(;*text;text++) {
        const uint8_t *fc = font_char(*text);
        oled_bytes_noflush(fc, 5);
        oled_fill_noflush(0, 1);
        oled_flush();
    }
    oled_cs(1);
}


const unsigned char font[] = {
    0x00, 0x00, 0x00, 0x00, 0x00, 0x3E, 0x5B, 0x4F, 0x5B, 0x3E, 0x3E, 0x6B,
    0x4F, 0x6B, 0x3E, 0x1C, 0x3E, 0x7C, 0x3E, 0x1C, 0x18, 0x3C, 0x7E, 0x3C,
    0x18, 0x1C, 0x57, 0x7D, 0x57, 0x1C, 0x1C, 0x5E, 0x7F, 0x5E, 0x1C, 0x00,
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    0x14, 0x08, 0x55, 0x00, 0x55, 0x00, 0x55, // #176 (25% block) missing in old
                                              // code
    0xAA, 0x55, 0xAA, 0x55, 0xAA,             // 50% block
    0xFF, 0x55, 0xFF, 0x55, 0xFF,             // 75% block
    0x00, 0x00, 0x00, 0xFF, 0x00, 0x10, 0x10, 0x10, 0xFF, 0x00, 0x14, 0x14,
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    0x3C, 0x00, 0x00, 0x00, 0x00, 0x00 // #255 NBSP
};

#endif
