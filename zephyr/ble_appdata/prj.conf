## CMakeLists.txt
```
../ble_simple/CMakeLists.txt
```

## prj.conf
```kconfig
../ble_simple/prj.conf
```

## src/main.c
```c
/* Example for appdata.h characteristic abstraction layer. */

#include "appdata.h"

#include <zephyr/types.h>
#include <stddef.h>
#include <string.h>
#include <errno.h>
#include <sys/printk.h>
#include <sys/byteorder.h>
#include <zephyr.h>

#include <settings/settings.h>

#include <bluetooth/bluetooth.h>
#include <bluetooth/hci.h>
#include <bluetooth/conn.h>
#include <bluetooth/uuid.h>
#include <bluetooth/gatt.h>

#include <stdint.h>

#include "spec_impl.h"

/* Instantiate a union appdata variable for each of these explicitly,
   together with get/set functions.  Later these can be replaced by
   abstract get/set functions if needed.

   The get/set functions are referenced by the metatdata instantiation
   below. */
DEF_VAR_GET_SET(char11)
DEF_VAR_GET_SET(char12)
DEF_VAR_GET_SET(char13)
DEF_VAR_GET_SET(char21)

/* Currently all config change messages go through this function.
   This might not be how it is supposed to be...  The function is
   referenced in the instantation below, so defined it first. */
static void characteristic_ccc_cfg_changed(const struct bt_gatt_attr *attr, u16_t value) {
    printk("ccc %p %d\n", attr, value);
}

/* Instantiate appdata.h metadata structs and BT services. */
INSTANTIATE_APPDATA
INSTANTIATE_BT_SERVICES

/* Now we just need to advertise the services. */
static const struct bt_data ad[] = {
    BT_DATA_BYTES(
        BT_DATA_FLAGS,
        (BT_LE_AD_GENERAL | BT_LE_AD_NO_BREDR)),
    BT_DATA_BYTES(
        BT_DATA_UUID16_ALL,
        // All services
        0xA0, 0xFF,
        0xB0, 0xFF,
        0xC0, 0xFF,
        0xD0, 0xFF,
        0xe0, 0xFF),
};

static void connected(struct bt_conn *conn, u8_t err) {
    if (err) {
        printk("Connection failed (err 0x%02x)\n", err);
    } else {
        printk("Connected\n");
    }
}
static void disconnected(struct bt_conn *conn, u8_t reason) {
    printk("Disconnected (reason 0x%02x)\n", reason);
}
static struct bt_conn_cb conn_callbacks = {
	.connected = connected,
	.disconnected = disconnected,
};
static void start_bluetooth(void) {
    int err;
    if ((err = bt_enable(NULL))) {
        printk("Bluetooth init failed (err %d)\n", err);
        return;
    }
    printk("Bluetooth initialized\n");

    /* This is necessary.  Otherwise error -11 is returned. */
    if (IS_ENABLED(CONFIG_SETTINGS)) { settings_load(); }

    err = bt_le_adv_start(BT_LE_ADV_CONN_NAME, ad, ARRAY_SIZE(ad), NULL, 0);
    if (err) {
        printk("Advertising failed to start (err %d)\n", err);
        return;
    }
    printk("Advertising successfully started\n");
}

static void auth_passkey_display(struct bt_conn *conn, unsigned int passkey) {
    char addr[BT_ADDR_LE_STR_LEN];
    bt_addr_le_to_str(bt_conn_get_dst(conn), addr, sizeof(addr));
    printk("Passkey for %s: %06u\n", addr, passkey);
}
static void auth_cancel(struct bt_conn *conn) {
    char addr[BT_ADDR_LE_STR_LEN];
    bt_addr_le_to_str(bt_conn_get_dst(conn), addr, sizeof(addr));
    printk("Pairing cancelled: %s\n", addr);
}
static struct bt_conn_auth_cb auth_cb_display = {
    .passkey_display = auth_passkey_display,
    .passkey_entry = NULL,
    .cancel = auth_cancel,
};


/* Search in the bt_gatt_service_static for our characteristic
   metadata, to obtain the correct bt_gatt_attr that needs to be
   passed to bt_gatt_notify.  Because all this is static, I cannot se
   a straightforward way to avoid this search. */
const struct bt_gatt_attr *find_characteristic(
    const struct bt_gatt_service_static *s,
    const struct appdata_characteristic *c) {
    for(int i=0; i<s->attr_count; i++) {
        const struct bt_gatt_attr *a = &s->attrs[i];
        if (a->user_data == c) { return a; }
    }
    return NULL;
}
void notify(const struct bt_gatt_service_static *s,
            const struct appdata_characteristic *c) {
    const struct bt_gatt_attr *attr = find_characteristic(s, c);
    if (!attr) {
        printk("no bt_gatt_service_static for characteristic %p\n", c);
        return;
    }
    const union appdata *data = c->get ? c->get() : 0;
    if (data) {
        //printk("notify %s\n", c->desc);
        bt_gatt_notify(NULL, attr, data, c->len);
    }
    else {
        printk("no data for characteristic %p\n", c);
    }
}


void main(void) {

    printk_services(services);

    start_bluetooth();
    bt_conn_cb_register(&conn_callbacks);
    bt_conn_auth_cb_register(&auth_cb_display);

    /* Implement notification. At the moment there is no suitable way
     * of starting delayed work so we do it here. */
    while (1) {

        k_sleep(K_SECONDS(1));

        notify(&serv1, &characteristic_char13);
        notify(&serv2, &characteristic_char21);

        union appdata a;

        a = *get_char13();
        a.u32++;
        set_char13(&a);

        a = *get_char21();
        a.u32++;
        set_char21(&a);

    }
}
```

## src/appdata.c
```c
#include "appdata.h"

/* Generic read/write routines for appdatas.  These assume that
   attr->user_data is of type struct appdata. */

#ifndef EMU
ssize_t appdata_read(
    struct bt_conn *conn, const struct bt_gatt_attr *attr,
    void *buf, uint16_t len, uint16_t offset) {
    const struct appdata_characteristic *c = attr->user_data;
    const union appdata *appdata = c->get ? c->get() : NULL;

    if (appdata) {
        printk("appdata_read: %s (len=%d)\n", c->desc, c->len);
        return bt_gatt_attr_read(
            conn, attr,
            buf, len, offset,
            appdata,
            c->len);
    }
    else {
        printk("appdata_read: no getter\n");
        return 0;
    }
}
ssize_t appdata_write(
    struct bt_conn *conn, const struct bt_gatt_attr *attr,
    const void *buf, uint16_t len, uint16_t offset, uint8_t flags) {

    struct appdata_characteristic *c = attr->user_data;
    /* Only support whole value writes. */
    if (offset != 0) {
        printk("appdata_write: bad offset %d\n", offset);
        return BT_GATT_ERR(BT_ATT_ERR_INVALID_OFFSET);
    }
    if (len != c->len) {
        printk("appdata_write: bad len %d\n", len);
        return BT_GATT_ERR(BT_ATT_ERR_INVALID_ATTRIBUTE_LEN);
    }
    // FIXME: Implement ranges and throw BT_ATT_ERR_VALUE_NOT_ALLOWED?
    if (c->set) {
        printk("appdata_write: %s (len=%d)\n", c->desc, c->len);
        c->set(buf);
        return len;
    }
    else {
        printk("appdata_write: no setter\n");
        // FIXME :ERROR
        return 0;
    }
}
#endif

void for_appdatas(const struct appdata_service **services,
                  with_appdata_fn fn, void *ctx) {
    for (const struct appdata_service **s = services; *s; s++) {
        for (const struct appdata_characteristic **c = (*s)->characteristics; *c; c++) {
            fn(ctx, *s, *c);
        }
    }
}


void printk_appdata(void *ctx,
                    const struct appdata_service *s,
                    const struct appdata_characteristic *c) {
    // FIXME: this assumes 16-bit uuid, e.g.:
    //if (s->uuid.uuod == BT_UUID_TYPE_16) {}
    //if (c->uuid.uuod == BT_UUID_TYPE_16) {}
    printk("%04x %04x %s (%s)\n",
           s->uuid.uuid_16.val,
           c->uuid.uuid_16.val,
           c->desc, c->type);
}
void printk_services(const struct appdata_service **services) {
    for_appdatas(services, printk_appdata, NULL);
}
```

## src/appdata.h
```c
#ifndef APPDATA_H
#define APPDATA_H

#include "spec.h"

#ifndef EMU
#include <bluetooth/gatt.h>
#endif


/* Generic appdata sum type.
   This will be wrapped in two layers of metadata:
   - struct characteristic annotates get/set of appdata
   - struct service collects multiple characteristics.
   All metadat ais const an can go into Flash storage.

   Note that the indexing wrapper struct server isn't strictly
   necessary.  In principle the structure could be reconstructed from
   bt_gatt_service_static's user_data pointers, which will point to
   struct characteristic.  However, struct service is a little easier
   to use.
&*/
union appdata {
    uint32_t u32;
    uint16_t u16;
    uint8_t u8;
    float32_t float32;
    uint8_t raw[4];
};

/* Reuse the bluetooth/uuid.h structures.  Note that this has some
   Flash overhead in case the uids are 16 bit, but that doesn't really
   seem to be a problem. */
union appdata_uuid {
    struct bt_uuid     uuid;
    struct bt_uuid_16  uuid_16;
    struct bt_uuid_128 uuid_128;
};

/* All access is abstract through get/set methods. */
typedef void                 (*appdata_set_fn)(const union appdata *value);
typedef const union appdata* (*appdata_get_fn)(void);

struct appdata_characteristic {
    union appdata_uuid uuid;
    appdata_get_fn get;
    appdata_set_fn set;
    uint16_t len;
    const char *desc;
    const char *type;
};
struct appdata_service {
    union appdata_uuid uuid;
    const char *desc;
    const struct appdata_characteristic **characteristics;
};

typedef void (*with_appdata_fn)(void *, const struct appdata_service *, const struct appdata_characteristic *);
void for_appdatas(const struct appdata_service **, with_appdata_fn fn, void *ctx);
void printk_services(const struct appdata_service **);

#ifndef EMU
ssize_t appdata_read(
    struct bt_conn *conn, const struct bt_gatt_attr *attr,
    void *buf, u16_t len, u16_t offset);

ssize_t appdata_write(
    struct bt_conn *conn, const struct bt_gatt_attr *attr,
    const void *buf, u16_t len, u16_t offset, u8_t flags);
#endif

#endif
```

## src/spec.h
```c
#ifndef SPEC_H
#define SPEC_H

// LICENCE: Apache-2.0

#include <stdint.h>

/* Example specification file for services and characteristics. */
typedef float float32_t;

/* Combinations of capabilities are implemented explicitly.  Currently
   these 4 combinations are supported: RW,R,RN,RWN.

   R: read
   W: write
   N: notify

   Indications are currently not supported.
*/

#define UUID_MIDI \
    UUID_128(0x03, 0xB8, 0x0E, 0x5A, \
             0xED, 0xE8, \
             0x4B, 0x33, \
             0xA7, 0x51, \
             0x6C, 0xE3, 0xE, 0xC4, 0xC7, 0x00)


// C Name  | Description             | UUID              | Data Type | Capabilities | Notes
//-----------------------------------------------------------------------------------------
#define FOR_CHARACTERISTICS_SERV1(C) \
C(char11,    "Serv1, Char1",           UUID_16(0xFF11),    uint8_t,    RW,            "") \
C(char12,    "Serv1, Char2",           UUID_16(0xFF12),    uint16_t,   R,             "") \
C(char13,    "Serv1, Char3",           UUID_16(0xFF13),    float32_t,  RN,            "") \

#define FOR_CHARACTERISTICS_SERV2(C) \
C(char21,    "Serv2, Char1",           UUID_16(0xFF21),    int32_t,    RWN,           "") \

// C Name  | Description  | UUID             | Characteristics
//-------------------------------------------------------------------------
#define FOR_SERVICES(S) \
S(serv1,    "Service 1",    UUID_MIDI,         FOR_CHARACTERISTICS_SERV1) \
S(serv2,    "Service 2",    UUID_16(0xFF20),   FOR_CHARACTERISTICS_SERV2) \


#endif
```

## src/spec_impl.h
```c
/* Instantiation macros for spec.h tables. */

// LICENCE: Apache-2.0

#ifndef SPEC_IMPL_H
#define SPEC_IMPL_H

/* These are referenced in spec.h and implemented in terms of Zephyr's
   bluetooth/uuid.h */
#define UUID_16(_uuid)  {.uuid_16  = BT_UUID_INIT_16(_uuid) }

/* It is a pain to read 128 bit uids backwards, so this does the byte
   reversal. That keeps the spec.h more readable. */
#define UUID_128(b15,b14,b13,b12,b11,b10,b9,b8,b7,b6,b5,b4,b3,b2,b1,b0) \
    {.uuid_128 = BT_UUID_INIT_128(b0,b1,b2,b3,b4,b5,b6,b7,b8,b9,b10,b11,b12,b13,b14,b15) }

#include "spec.h"
#include "appdata.h"

/* 1. Map the spec.h tables (compile time iterators) to appdata
      structs. All metadata is const, and data for each characteristic
      is accessed abstractly through get/set methods. */

#define MAYBE_INIT_SET_APPDATA_RW(_cname)  .set = set_##_cname,
#define MAYBE_INIT_SET_APPDATA_RWN(_cname) .set = set_##_cname,
#define MAYBE_INIT_SET_APPDATA_R(_cname)
#define MAYBE_INIT_SET_APPDATA_RN(_cname)

// FIXME: support 128 bit.  This has some silly double union wrapping.
#define INIT_UUID(_uuid) {.uuid_16 = BT_UUID_INIT_16(_uuid)}

#define DEF_CHARACTERISTIC(_cname, _desc, _char_uuid, _type, _cap, _notes) \
    const struct appdata_characteristic characteristic_##_cname = {     \
        .get     = get_##_cname,                                        \
        .set     = set_##_cname,                                        \
        .desc    = _desc,                                               \
        .uuid    = _char_uuid,                                          \
        .len     = sizeof(_type),                                       \
        .type    = #_type,                                              \
        MAYBE_INIT_SET_APPDATA_##_cap(_cname)                           \
    };

#define REF_CHARACTERISTIC(_cname, _desc, _char_uuid, _type, _cap, _notes) \
    &characteristic_##_cname,

#define DEF_SERVICE(_cname, _desc, _serv_uuid, _FOR_CHARACTERISTICS)    \
    _FOR_CHARACTERISTICS(DEF_CHARACTERISTIC)                            \
    const struct appdata_characteristic *characteristics_##_cname[] = { \
        _FOR_CHARACTERISTICS(REF_CHARACTERISTIC) NULL                   \
    };                                                                  \
    const struct appdata_service service_##_cname = {                   \
        .desc = _desc,                                                  \
        .uuid = _serv_uuid,                                             \
        .characteristics = characteristics_##_cname                     \
    };
#define REF_SERVICE(_cname, _desc, _serv_uuid, _FOR_CHARACTERISTICS)    \
    &service_##_cname,

// Expand this in main.c
#define INSTANTIATE_APPDATA \
    FOR_SERVICES(DEF_SERVICE) \
    const struct appdata_service *services[] = { FOR_SERVICES(REF_SERVICE) NULL };


/* 2. Create declarations for all accessors. */

#define DECL_CHARACTERISTIC(_cname, _desc, _char_uuid, _type, _cap, _notes) \
    void set_##_cname(const union appdata *value);                      \
    const union appdata *get_##_cname(void);
#define DECL_SERVICE(_cname, _desc, _serv_uuid, _FOR_CHARACTERISTICS)   \
    _FOR_CHARACTERISTICS(DECL_CHARACTERISTIC)

FOR_SERVICES(DECL_SERVICE)


/* 3. If get/set doesn't need to be abstract, these can be used to
      create vars and get/set accessors. */

#define DEF_VAR(_var)                           \
    union appdata _var;
#define DEF_GET_SET(_cname, _var)                                       \
    void set_##_cname(const union appdata *value) {                     \
        *((union appdata *)(_var)) = *value;                            \
    }                                                                   \
    const union appdata *get_##_cname(void) {                           \
        return _var;                                                    \
    }
#define DEF_VAR_GET_SET(_cname)                                 \
    DEF_VAR(var_##_cname) DEF_GET_SET(_cname, &var_##_cname)


/* 4. BT_GATT_ abstractions.  For each capability type, there is a
      corresponding macro that can be spliced into the service
      definition. */

#define CHARACTERISTIC_RWN(_characteristic)                             \
    BT_GATT_CHARACTERISTIC(                                             \
        &_characteristic.uuid.uuid,                                     \
        BT_GATT_CHRC_READ | BT_GATT_CHRC_NOTIFY | BT_GATT_CHRC_WRITE,   \
        BT_GATT_PERM_READ | BT_GATT_PERM_WRITE,                         \
        appdata_read,                                                   \
        appdata_write,                                                  \
        (void*)&_characteristic),                                       \
    BT_GATT_CCC(                                                        \
        characteristic_ccc_cfg_changed,                                 \
        BT_GATT_PERM_READ | BT_GATT_PERM_WRITE_ENCRYPT)

#define CHARACTERISTIC_RN(_characteristic)                              \
    BT_GATT_CHARACTERISTIC(                                             \
        &_characteristic.uuid.uuid,                                     \
        BT_GATT_CHRC_READ | BT_GATT_CHRC_NOTIFY,                        \
        BT_GATT_PERM_READ,                                              \
        appdata_read,                                                   \
        NULL,                                                           \
        (void*)&_characteristic),                                       \
    BT_GATT_CCC(                                                        \
        characteristic_ccc_cfg_changed,                                 \
        BT_GATT_PERM_READ | BT_GATT_PERM_WRITE_ENCRYPT)

#define CHARACTERISTIC_R(_characteristic)                               \
    BT_GATT_CHARACTERISTIC(                                             \
        &_characteristic.uuid.uuid,                                     \
        BT_GATT_CHRC_READ,                                              \
        BT_GATT_PERM_READ,                                              \
        appdata_read,                                                   \
        NULL,                                                           \
        (void*)&_characteristic)                                        \

#define CHARACTERISTIC_RW(_characteristic)                              \
    BT_GATT_CHARACTERISTIC(                                             \
        &_characteristic.uuid.uuid,                                     \
        BT_GATT_CHRC_READ | BT_GATT_CHRC_WRITE,                         \
        BT_GATT_PERM_READ | BT_GATT_PERM_WRITE,                         \
        appdata_read,                                                   \
        appdata_write,                                                  \
        (void*)&_characteristic)

#define CHARACTERISTIC(_cname, _desc, _char_uuid, _type, _cap, _notes) \
    ,CHARACTERISTIC_##_cap(characteristic_##_cname)

// Note: referenceing uuid.uuid_16.uuid or uuid.uuid_128.uuid has the
// same effect.  FIXME: re-arrange this so the double wrapping is not
// necessary.

#define SERVICE(_cname, _desc, _serv_uuid, _FOR_CHARACTERISTICS) \
    BT_GATT_SERVICE_DEFINE(\
        _cname,\
        BT_GATT_PRIMARY_SERVICE((void*)&service_##_cname.uuid.uuid)\
        _FOR_CHARACTERISTICS(CHARACTERISTIC));

// Expand this in main.c
#define INSTANTIATE_BT_SERVICES FOR_SERVICES(SERVICE)

#endif
```
