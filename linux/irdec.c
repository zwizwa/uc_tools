#include "macros.h"
#include <stdint.h>
#include <string.h>

/* Captured from TV remote. Low bit is I/O value, high 127 bits are
   diff time in multiples of 0.1ms */

const uint8_t data[] = {
0xff,0xb4,0x57,0x0c,0x09,0x0c,0x1f,0x0c,
0x09,0x0c,0x09,0x0c,0x1f,0x0c,0x1f,0x0c,
0x09,0x0c,0x09,0x0c,0x1f,0x0c,0x09,0x0c,
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0xff,0xb4,0x2b,0x0c
};

/* To decode:
   - reset machine whenever a timeout occurs
   - wait for the 10ms preamble
   - then advance time, and count transitions
*/

#define FOR_DATA(i) for (int i=0; i<sizeof(data); i++)

void raw(void) {
    FOR_DATA(i) {
        uint8_t val = (data[i] & 1) ? 255:0;
        uint8_t count = data[i] >> 1;
        for (uint8_t j=0; j<count; j++) {
            fwrite(&val, 1, 1, stdout);
        }
    }
    fflush(stdout);
}


int main(int argc, char **argv) {
    LOG("irdec.c\n");
    if ((argc == 2) && (!strcmp("raw", argv[1]))) {
        LOG("raw data on stdout\n");
        raw();
        return 0;
    }
    for (int i=0; i<sizeof(data); i++) {
        LOG("%02x ", data[i]);
    }
    LOG("\n");
    return 0;
}
